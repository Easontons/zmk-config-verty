## config/boards/shields/worst_bread/Kconfig.defconfig
```kconfig
# Copyright (c) 2023 The ZMK Contributors
# SPDX-License-Identifier: MIT

config ZMK_BLE
 	default y


if SHIELD_VERTY_LEFT

config ZMK_KEYBOARD_NAME
	default "Verty"

config ZMK_SPLIT
	default y

config ZMK_SPLIT_ROLE_CENTRAL
	default y

config ZMK_USB
  	default y

endif # SHIELD_VERTY_LEFT


if SHIELD_VERTY_RIGHT

config ZMK_SPLIT
	default y

endif # SHIELD_VERTY_RIGHT
```

## config/boards/shields/worst_bread/Kconfig.shield
```kconfig
config SHIELD_VERTY_LEFT
	def_bool $(shields_list_contains,verty_left)

config SHIELD_VERTY_RIGHT
	def_bool $(shields_list_contains,verty_right)
```
